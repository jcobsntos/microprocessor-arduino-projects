#include "U8glib.h"
#include <DHT.h>

#define DHTPIN 2
#define DHTTYPE DHT11
#define AIR_QUALITY_PIN A0
DHT dht(DHTPIN, DHTTYPE);

// Setup u8g object
U8GLIB_SSD1306_128X64 u8g(U8G_I2C_OPT_NO_ACK); // Display which does not send AC

// Bitmaps
#define temperature_width 18
#define temperature_height 47
static const unsigned char temperature_bits[] PROGMEM = {
   0xc0, 0x0f, 0x00, 0xe0, 0x1f, 0x00, 0x70, 0x38, 0x00, 0x30, 0x30, 0x00,
   0x30, 0x30, 0x00, 0x30, 0x30, 0x00, 0x30, 0x30, 0x00, 0x30, 0x30, 0x00,
   0x30, 0x30, 0x00, 0xb0, 0x37, 0x00, 0xb0, 0x37, 0x00, 0x30, 0x30, 0x00,
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   0x38, 0x70, 0x00, 0xf0, 0x3f, 0x00, 0xc0, 0x0f, 0x00 };

#define humid_width 35
#define humid_height 48
static unsigned char humid_bits[] U8G_PROGMEM = {
   0x00, 0x00, 0x03, 0x00, 0x00, 0x00, 0x00, 0x07, 0x00, 0x00, 0x00, 0x80,
   0x0f, 0x00, 0x00, 0x00, 0xc0, 0x1f, 0x00, 0x00, 0x00, 0xe0, 0x1d, 0x00,
   0x00, 0x00, 0xe0, 0x38, 0x00, 0x00, 0x00, 0xf0, 0x78, 0x00, 0x00, 0x00,
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   0x07, 0x00, 0x00, 0xfc, 0xff, 0x01, 0x00, 0x00, 0xc0, 0x3f, 0x00, 0x00 };
uint8_t draw_state = 0;

// Function to read air quality from the sensor
int readAirQuality() {
  int sensorValue = analogRead(AIR_QUALITY_PIN);
  // Convert the analog reading to ppm (this will vary based on the specific sensor and calibration)
  // Here, we use a simple conversion for demonstration purposes
  int ppm = map(sensorValue, 0, 1023, 0, 1000);
  return ppm;
}

// Function to get air quality category based on ppm value
String getAirQualityCategory(int ppm) {
  if (ppm < 151) return "Good";
  else if (ppm < 200) return "Fair";
  else if (ppm < 300) return "Poor";
  else if (ppm < 500) return "Toxic";
  else return "Danger";
}

void draw() {
  u8g.setFont(u8g_font_unifont);
  u8g.setPrintPos(0, 10);

  switch(draw_state) {
    case 0: {
      u8g.print("TEMPERATURE  1/4");
      u8g.setFont(u8g_font_fub14);
      u8g.setPrintPos(10, 50);
      int temp = round(dht.readTemperature() * 10) / 10.0;
      u8g.print(String(temp) + " C");
      u8g.drawXBMP(80, 16, temperature_width, temperature_height, temperature_bits);
      break;
    }
    case 1: {
      u8g.print("HUMIDITY     2/4");
      u8g.setFont(u8g_font_fub14);
      u8g.setPrintPos(10, 50);
      u8g.print(String(int(dht.readHumidity())) + "%");
      u8g.drawXBMP(80, 16, humid_width, humid_height, humid_bits);
      break;
    }
    case 2: {
      u8g.print("HEAT INDEX   3/4");
      u8g.setFont(u8g_font_fub14);
      u8g.setPrintPos(10, 50);
      int hic = round(dht.computeHeatIndex(dht.readTemperature(), dht.readHumidity(), false) * 10) / 10.0;
      u8g.print(String(hic) + " C");
      break;
    }
    case 3: {
      u8g.print("AIR QUALITY  4/4");
      u8g.setFont(u8g_font_fub11);
      u8g.setPrintPos(0, 30);
      int airQuality = readAirQuality();
      String airQualityCategory = getAirQualityCategory(airQuality);
      u8g.print(String(airQuality) + " ppm");
      u8g.setPrintPos(0, 50);
      u8g.print("Status: " + airQualityCategory);
      break;
    }
  }
}

void setup() {
  Serial.begin(9600);
  dht.begin();
}

void loop() {
  u8g.firstPage();
  do {
    draw();
  } while (u8g.nextPage());

  draw_state = (draw_state + 1) % 4;
  delay(2000);
}
